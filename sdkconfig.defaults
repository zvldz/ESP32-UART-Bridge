## sdkconfig.defaults
```kconfig
# Only essential options for USB Host + Arduino
CONFIG_AUTOSTART_ARDUINO=y
CONFIG_FREERTOS_HZ=1000
CONFIG_USB_HOST_ENABLED=y
CONFIG_USB_HOST_TASK_PRIORITY=5
CONFIG_USB_HOST_CONTROL_TRANSFER_MAX_SIZE=256
CONFIG_USB_HOST_DEBOUNCE_DELAY_MS=150
CONFIG_USB_HOST_PRIORITY=2
CONFIG_USB_HCD_USE_DMA=n
CONFIG_USB_HCD_BULK_ONLY_TRANSFER=y
CONFIG_USB_HCD_QUEUE_TIMEOUT_MS=1000
CONFIG_USB_HCD_MAX_NUM_ENDPOINTS=6
CONFIG_USB_HCD_MAX_NUM_DEVICES=4
CONFIG_USB_HCD_DEBUG_LEVEL_NONE=y

CONFIG_SPIRAM=y
CONFIG_SPIRAM_MODE_OCT=y
CONFIG_ESPTOOLPY_FLASHSIZE="4MB"
CONFIG_ESPTOOLPY_FLASHSIZE_4MB=y
CONFIG_SPIRAM_BOOT_INIT=y
CONFIG_SPIRAM_IGNORE_NOTFOUND=n
CONFIG_SPIRAM_USE_CAPS_ALLOC=y
CONFIG_SPIRAM_TYPE_AUTO=y
CONFIG_SPIRAM_SIZE=2097152
CONFIG_SPIRAM_ALLOW_BSS_SEG_EXTERNAL_MEMORY=y

CONFIG_ESP_INSIGHTS=n
CONFIG_ESP_DSP=n
CONFIG_ESP_MODBUS=n
CONFIG_RMAKER_COMMON=n
```
